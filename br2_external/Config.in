## br2_external/Config.in
```kconfig
menu "PI4 AV external packages"

source "$BR2_EXTERNAL_PI4_AV_EXTERNAL_PATH/package/av_services/Config.in"
source "$BR2_EXTERNAL_PI4_AV_EXTERNAL_PATH/package/pi4_feature_check/Config.in"

endmenu
```

## br2_external/package/av_services/Config.in
```kconfig
config BR2_PACKAGE_AV_SERVICES
	bool "av_services"
	select BR2_PACKAGE_LIBCURL
	select BR2_PACKAGE_LIBCURL_FORCE_TLS
	select BR2_PACKAGE_OPENSSL
	select BR2_PACKAGE_LIBCURL_OPENSSL
	select BR2_PACKAGE_PYTHON_PAHO_MQTT
	select BR2_PACKAGE_PYTHON_PSUTIL
	help
	  Cross-build and install av_services runtime binaries,
	  default config files, and service startup units.
	  Installs systemd .service units when BR2_INIT_SYSTEMD=y,
	  or a BusyBox SysV init script otherwise.
```

## br2_external/package/pi4_feature_check/Config.in
```kconfig
config BR2_PACKAGE_PI4_FEATURE_CHECK
	bool "pi4_feature_check"
	depends on BR2_INIT_SYSTEMD
	help
	  Installs a boot-time feature verification script and report
	  generator for Raspberry Pi 4 AV runtime images.
	  The service runs after boot and writes a report to:
	  /var/log/pi4_feature_report.md
```

## configs/pi4_64_defconfig
```kconfig
BR2_aarch64=y
BR2_cortex_a72=y
BR2_ARM_FPU_VFPV4=y
BR2_TOOLCHAIN_EXTERNAL=y
BR2_TOOLCHAIN_EXTERNAL_BOOTLIN=y
BR2_TOOLCHAIN_EXTERNAL_BOOTLIN_AARCH64_GLIBC_STABLE=y
BR2_GLOBAL_PATCH_DIR="board/raspberrypi/patches"
BR2_DOWNLOAD_FORCE_CHECK_HASHES=y
BR2_SYSTEM_DHCP="eth0"
BR2_ROOTFS_POST_BUILD_SCRIPT="board/raspberrypi4-64/post-build.sh"
BR2_ROOTFS_POST_IMAGE_SCRIPT="board/raspberrypi4-64/post-image.sh"
BR2_LINUX_KERNEL=y
BR2_LINUX_KERNEL_CUSTOM_TARBALL=y
BR2_LINUX_KERNEL_CUSTOM_TARBALL_LOCATION="$(call github,raspberrypi,linux,21b410140c47ffab5668399f6f143c7d7b935c8b)/linux-21b410140c47ffab5668399f6f143c7d7b935c8b.tar.gz"
BR2_LINUX_KERNEL_DEFCONFIG="bcm2711"
BR2_LINUX_KERNEL_DTS_SUPPORT=y
BR2_LINUX_KERNEL_INTREE_DTS_NAME="broadcom/bcm2711-rpi-4-b broadcom/bcm2711-rpi-400 broadcom/bcm2711-rpi-cm4 broadcom/bcm2711-rpi-cm4s"
BR2_LINUX_KERNEL_NEEDS_HOST_OPENSSL=y
BR2_PACKAGE_BUSYBOX_SHOW_OTHERS=y
BR2_PACKAGE_XZ=y
BR2_PACKAGE_RPI_FIRMWARE=y
BR2_PACKAGE_RPI_FIRMWARE_VARIANT_PI4=y
BR2_PACKAGE_RPI_FIRMWARE_CONFIG_FILE="board/raspberrypi4-64/config_4_64bit.txt"
BR2_PACKAGE_KMOD=y
BR2_PACKAGE_KMOD_TOOLS=y
BR2_PACKAGE_PYTHON3=y
BR2_PACKAGE_PYTHON3_READLINE=y
BR2_PACKAGE_PYTHON3_SSL=y
BR2_PACKAGE_PYTHON3_BZIP2=y
BR2_PACKAGE_PYTHON3_XZ=y
BR2_PACKAGE_PYTHON3_ZLIB=y
BR2_PACKAGE_PYTHON_PIP=y
BR2_PACKAGE_PYTHON_NUMPY=y
BR2_PACKAGE_PYTHON_PYYAML=y
BR2_PACKAGE_OPENCV4=y
BR2_PACKAGE_OPENCV4_LIB_DNN=y
BR2_PACKAGE_OPENCV4_LIB_VIDEOIO=y
BR2_PACKAGE_OPENCV4_WITH_GSTREAMER1=y
BR2_PACKAGE_OPENCV4_WITH_V4L=y
BR2_PACKAGE_GSTREAMER1=y
BR2_PACKAGE_GSTREAMER1_INSTALL_TOOLS=y
BR2_PACKAGE_GST1_PLUGINS_BASE=y
BR2_PACKAGE_GST1_PLUGINS_GOOD=y
BR2_PACKAGE_GST1_PLUGINS_GOOD_PLUGIN_V4L2=y
BR2_PACKAGE_GST1_PLUGINS_GOOD_PLUGIN_RTP=y
BR2_PACKAGE_GST1_PLUGINS_GOOD_PLUGIN_RTPMANAGER=y
BR2_PACKAGE_GST1_PLUGINS_GOOD_PLUGIN_RTSP=y
BR2_PACKAGE_CAN_UTILS=y
BR2_PACKAGE_LIBSOCKETCAN=y
BR2_PACKAGE_I2C_TOOLS=y
BR2_PACKAGE_LIBGPIOD2=y
BR2_PACKAGE_LIBGPIOD2_TOOLS=y
BR2_PACKAGE_GPSD=y
BR2_PACKAGE_GPSD_DAEMON=y
BR2_PACKAGE_GPSD_CLIENTS=y
BR2_PACKAGE_MOSQUITTO=y
BR2_PACKAGE_MOSQUITTO_CLIENTS=y
BR2_PACKAGE_MOSQUITTO_BROKER=y
BR2_PACKAGE_ZEROMQ=y
BR2_PACKAGE_IPERF3=y
BR2_PACKAGE_TCPDUMP=y
BR2_PACKAGE_ETHTOOL=y
BR2_PACKAGE_IPROUTE2=y
BR2_PACKAGE_CHRONY=y
BR2_PACKAGE_LINUXPTP=y
BR2_PACKAGE_EIGEN=y
BR2_PACKAGE_FFMPEG=y
BR2_PACKAGE_FFMPEG_FFPROBE=y
BR2_TARGET_ROOTFS_EXT2=y
BR2_TARGET_ROOTFS_EXT2_4=y
BR2_TARGET_ROOTFS_EXT2_SIZE="2048M"
# BR2_TARGET_ROOTFS_TAR is not set
BR2_PACKAGE_HOST_DOSFSTOOLS=y
BR2_PACKAGE_HOST_GENIMAGE=y
BR2_PACKAGE_HOST_KMOD_XZ=y
BR2_PACKAGE_HOST_MTOOLS=y
```
